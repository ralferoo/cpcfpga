iy_current_spi_status                                            equ     0
iy_is_writing                                                    equ     1
iy_write_spi_offset                                              equ     2
iy_is_reading                                                    equ     5
iy_read_spi_offset                                               equ     6
iy_long_jump_vector                                              equ     9
iy_existing_tape_in                                              equ    12
iy_existing_tape_out                                             equ    14
iy_read_scratch_buffer                                           equ    16
iy_read_name                                                     equ    18
iy_read_name_len                                                 equ    20
iy_read_page_low                                                 equ    21
iy_read_page_high                                                equ    22
iy_read_page_ofs                                                 equ    23
iy_amsdos_header_write                                           equ    24
iy_amsdos_header_read                                            equ    88
iy_saved_cas_vectors                                             equ   152
iy_data_area_size                                                equ   191
